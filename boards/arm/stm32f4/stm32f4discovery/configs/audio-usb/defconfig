## boards/arm/stm32f4/stm32f4discovery/configs/audio-usb/defconfig
```kconfig
#
# STM32F407 Discovery USB Audio Class 1.0 playback firmware
# 48 kHz / 16-bit / stereo -> CS43L22 over I2S3
#
# CONFIG_ARCH_FPU is not set
# CONFIG_NSH_ARGCAT is not set
# CONFIG_NSH_CMDOPT_HEXDUMP is not set
CONFIG_ARCH="arm"
CONFIG_ARCH_BOARD="stm32f4discovery"
CONFIG_ARCH_BOARD_STM32F4_DISCOVERY=y
CONFIG_ARCH_BUTTONS=y
CONFIG_ARCH_CHIP="stm32f4"
CONFIG_ARCH_CHIP_STM32=y
CONFIG_ARCH_CHIP_STM32F407VG=y
CONFIG_ARCH_CHIP_STM32F4=y
CONFIG_ARCH_STACKDUMP=y
CONFIG_AUDIO=y
CONFIG_AUDIOUTILS_NXAUDIO_DEVPATH="/dev/audio/pcm1"
CONFIG_AUDIOUTILS_NXAUDIO_LIB=y
CONFIG_AUDIOUTILS_NXAUDIO_MSGQNAME="/tmp/uacplay_mq"
CONFIG_AUDIO_CS43L22=y
CONFIG_AUDIO_CUSTOM_DEV_PATH=y
CONFIG_AUDIO_EXCLUDE_TONE=y
CONFIG_BOARD_LOOPSPERMSEC=16717
CONFIG_BUILTIN=y
CONFIG_CS43L22_BUFFER_SIZE=1536
CONFIG_CS43L22_NUM_BUFFERS=4
CONFIG_DRIVERS_AUDIO=y
CONFIG_HAVE_CXX=y
CONFIG_HAVE_CXXINITIALIZE=y
CONFIG_I2C=y
CONFIG_I2C_DRIVER=y
CONFIG_I2C_POLLED=y
CONFIG_I2C_RESET=y
CONFIG_INIT_ENTRYPOINT="uacplay_main"
CONFIG_INTELHEX_BINARY=y
CONFIG_LINE_MAX=64
CONFIG_MM_REGIONS=2
CONFIG_PREALLOC_TIMERS=4
CONFIG_RAM_SIZE=114688
CONFIG_RAM_START=0x20000000
CONFIG_RAW_BINARY=y
CONFIG_RR_INTERVAL=200
CONFIG_SCHED_HPWORK=y
CONFIG_SCHED_WAITPID=y
CONFIG_START_DAY=6
CONFIG_START_MONTH=12
CONFIG_START_YEAR=2011
CONFIG_STM32_DMA1=y
CONFIG_STM32_DMACAPABLE=y
CONFIG_STM32_I2C1=y
CONFIG_STM32_I2S3=y
CONFIG_STM32_I2S3_TX=y
CONFIG_STM32_I2S_MCK=y
CONFIG_STM32_JTAG_SW_ENABLE=y
CONFIG_STM32_OTGFS=y
CONFIG_STM32_PWR=y
CONFIG_STM32_SPI1=y
CONFIG_STM32_SPI3=y
CONFIG_STM32_USART2=y
CONFIG_SYSTEM_UACPLAY=y
CONFIG_SYSTEM_UACPLAY_AUDIODEV="/dev/audio/pcm1"
CONFIG_SYSTEM_UACPLAY_PRIORITY=150
CONFIG_SYSTEM_UACPLAY_PROGNAME="uacplay"
CONFIG_SYSTEM_UACPLAY_STACKSIZE=3072
CONFIG_SYSTEM_UACPLAY_USBDEV="/dev/uac1"
CONFIG_UAC1=y
CONFIG_UAC1_NRDREQS=16
CONFIG_UAC1_PRODUCTID=0x5740
CONFIG_UAC1_PRODUCTSTR="STM32F407 NuttX Audio"
CONFIG_UAC1_SERIALSTR="F407AUDIO"
CONFIG_UAC1_VENDORID=0x0483
CONFIG_UAC1_VENDORSTR="NuttX"
CONFIG_USBDEV=y
CONFIG_USBDEV_ISOCHRONOUS=y
CONFIG_USART2_RXBUFSIZE=128
CONFIG_USART2_SERIAL_CONSOLE=y
CONFIG_USART2_TXBUFSIZE=128
```
